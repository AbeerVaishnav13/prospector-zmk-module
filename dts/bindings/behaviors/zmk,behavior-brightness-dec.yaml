## dts/bindings/behaviors/zmk,behavior-brightness-dec.yaml
```yaml
description: Decrease display brightness

compatible: "zmk,behavior-brightness-dec"

include: zero_param.yaml
```

## dts/bindings/behaviors/zmk,behavior-brightness-inc.yaml
```yaml
description: Increase display brightness

compatible: "zmk,behavior-brightness-inc"

include: zero_param.yaml
```

## dts/bindings/behaviors/zmk,behavior-display-rotation-toggle.yaml
```yaml
description: Toggle Prospector display orientation by 180 degrees

compatible: "zmk,behavior-display-rotation-toggle"

include: zero_param.yaml
```
