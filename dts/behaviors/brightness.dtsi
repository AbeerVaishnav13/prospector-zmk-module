/ {
    behaviors {
        inc_bri: inc_bri {
            compatible = "zmk,behavior-brightness-inc";
            #binding-cells = <0>;
        };
        dec_bri: dec_bri {
            compatible = "zmk,behavior-brightness-dec";
            #binding-cells = <0>;
        };
    };
};
